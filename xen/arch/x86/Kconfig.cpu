## xen/arch/x86/Kconfig.cpu
```kconfig
menu "Supported CPU vendors"
	visible if EXPERT

config AMD
	bool "Support AMD CPUs"
	default y
	help
	  Detection, tunings and quirks for AMD platforms.

	  May be turned off in builds targetting other vendors.  Otherwise,
	  must be enabled for Xen to work suitably on AMD platforms.

config INTEL
	bool "Support Intel CPUs"
	default y
	help
	  Detection, tunings and quirks for Intel platforms.

	  May be turned off in builds targetting other vendors.  Otherwise,
	  must be enabled for Xen to work suitably on Intel platforms.

config HYGON
	bool "Support Hygon CPUs"
	depends on AMD
	default y
	help
	  Detection, tunings and quirks for Hygon platforms.

	  May be turned off in builds targetting other vendors.  Otherwise,
	  must be enabled for Xen to work suitably on Hygon platforms.

config CENTAUR
	bool "Support Centaur CPUs"
	depends on INTEL
	default y
	help
	  Detection, tunings and quirks for Centaur platforms.

	  May be turned off in builds targetting other vendors.  Otherwise,
	  must be enabled for Xen to work suitably on Centaur platforms.

config SHANGHAI
	bool "Support Shanghai CPUs"
	depends on INTEL
	default y
	help
	  Detection, tunings and quirks for Shanghai platforms.

	  May be turned off in builds targetting other vendors.  Otherwise,
	  must be enabled for Xen to work suitably on Shanghai platforms.

endmenu
```

## xen/arch/x86/hvm/Kconfig
```kconfig
menuconfig HVM
	bool "HVM support"
	depends on !PV_SHIM_EXCLUSIVE
	default !PV_SHIM
	help
	  Interfaces to support HVM domains.  HVM domains require hardware
	  virtualisation extensions (e.g. Intel VT-x, AMD SVM), but can boot
	  guests which have no specific Xen knowledge.

	  This option is needed if you want to run HVM or PVH domains.

	  If unsure, say Y.

if HVM

config AMD_SVM
	bool "AMD-V" if EXPERT
	default AMD
	help
	  Enables virtual machine extensions on platforms that implement the
	  AMD Virtualization Technology (AMD-V).
	  If your system includes a processor with AMD-V support, say Y.
	  If in doubt, say Y.

config INTEL_VMX
	bool "Intel VT-x" if EXPERT
	default INTEL
	help
	  Enables virtual machine extensions on platforms that implement the
	  Intel Virtualization Technology (Intel VT-x).
	  If your system includes a processor with Intel VT-x support, say Y.
	  If in doubt, say Y.

config VMX_REALMODE_EMUL
	bool "VT-x real mode emulation" if EXPERT && !SHADOW_PAGING
	depends on INTEL_VMX
	default y
	select ARCH_VCPU_IOREQ_COMPLETION
	help
	  Runs guest real mode code in vm86 mode, and emulates what vm86 mode
	  cannot run, on Intel CPUs without Unrestricted Guest (or with it
	  disabled by "unrestricted_guest=0").  Shadow paging needs it.

	  Without it, VT-x is only used on CPUs with Unrestricted Guest (all
	  CPUs since Westmere), HVM guests must use HAP, and the
	  "unrestricted_guest" command line option is not recognised.

	  If unsure, say Y.

# The p2m in page table format, used with AMD NPT and with shadow paging.
# Intel EPT has its own format.
config P2M_PT
	def_bool AMD_SVM || SHADOW_PAGING

config VMTRACE
	bool "HW VM tracing support"
	depends on INTEL_VMX
	default y
	help
	  Enables HW VM tracing support which allows to configure HW processor
	  features (vmtrace_op) to enable capturing information about software
	  execution using dedicated hardware facilities with minimal interference
	  to the software being traced. The trace data can be retrieved using buffer
	  shared between Xen and domain
	  (see XENMEM_acquire_resource(XENMEM_resource_vmtrace_buf)).

config HVM_COMPAT
	bool "HVM 32-bit compat hypercall support" if EXPERT
	select COMPAT
	default y
	help
	  Support hypercalls from HVM and PVH guest code running in 32-bit or
	  16-bit mode.  Hypercalls from 64-bit code are always supported.

	  Without it such hypercalls fail with -ENOSYS.  HVM guests need them
	  for hvmloader, so only 64-bit PVH guests that make no hypercall
	  before entering long mode can run.

	  If unsure, say Y.

config HVM_FEP
	bool "HVM Forced Emulation Prefix support (UNSUPPORTED)" if UNSUPPORTED
	default DEBUG
	help
	  Compiles in a feature that allows HVM guest to arbitrarily
	  exercise the instruction emulator.

	  This feature can only be enabled during boot time with
	  appropriate hypervisor command line option. Please read
	  hypervisor command line documentation before trying to use
	  this feature.

	  This is strictly for testing purposes, and not appropriate
	  for use in production.

	  If unsure, say N.

config HVM_EMUL_SIMD
	bool "Emulation of x87, MMX and SIMD instructions" if EXPERT
	default y
	help
	  The instruction emulator handles HVM guest instructions that access
	  emulated MMIO (local APIC, IO-APIC, PCI config space, MSI-X tables)
	  or that Xen otherwise intercepts.  Without this option it cannot
	  emulate x87 FPU, MMX, SSE or AVX instructions: a guest using one
	  for such an access gets #UD instead.

	  If unsure, say Y.

config ALTP2M
	bool "Alternate P2M support" if EXPERT
	depends on INTEL_VMX
	default y
	help
	  Alternate-p2m allows a guest to manage multiple p2m guest physical
	  "memory views" (as opposed to a single p2m).
	  Useful for memory introspection.

	  If unsure, stay with defaults.

config NESTED_VIRT
	bool "Nested virtualization support" if EXPERT
	default y
	help
	  Support for HVM guests running their own hypervisor: nested VT-x or
	  SVM, with nested HAP, for domains created with nested
	  virtualization enabled.

	  Without it, creating such a domain fails, and guests get #UD on
	  VMX and SVM instructions, as all domains without nested
	  virtualization do.

	  If unsure, say Y.

config VIRIDIAN
	bool "Hyper-V enlightenments for guests" if EXPERT
	default y
	help
	  Support optimizations for Hyper-V guests such as hypercalls, efficient
	  timers and interrupt handling. This is to improve performance and
	  compatibility of Windows VMs.

	  If unsure, say Y.

config HVM_PIRQ
	bool "Event channel delivery of device interrupts to HVM guests" if EXPERT
	default y
	help
	  Lets an HVM guest created with XEN_X86_EMU_USE_PIRQ take device
	  interrupts as event channels instead of through its emulated
	  IO-APIC and local APIC (XENFEAT_hvm_pirqs, used by Linux "PVHVM"
	  guests): PHYSDEVOP_eoi, PHYSDEVOP_irq_status_query,
	  PHYSDEVOP_get_free_pirq, PHYSDEVOP_map_pirq on itself and
	  EVTCHNOP_bind_pirq.  PVH guests never use them.

	  Without it, creating a domain with XEN_X86_EMU_USE_PIRQ fails with
	  -EOPNOTSUPP, and with PV also off these sub-ops return -ENOSYS or
	  -EOPNOTSUPP.

	  If unsure, say Y.

config MEM_PAGING
	bool "Xen memory paging support (UNSUPPORTED)" if UNSUPPORTED
	depends on VM_EVENT

config MEM_SHARING
	bool "Xen memory sharing support (UNSUPPORTED)" if UNSUPPORTED
	depends on INTEL_VMX || AMD_SVM

endif

menu "Emulated HVM devices support"
	visible if EXPERT && HVM

config X86_HVM_PIT
	bool "i8254 PIT emulation" if !PV
	default y
	help
	  Emulated i8254 Programmable Interval Timer and PC speaker port
	  (I/O ports 0x40-0x43 and 0x61).  PV domains use it too (a PV dom0
	  always does), so it can only be disabled when PV support is.

	  PVH guests and a PVH dom0 do not use it.  Without it, HVM guests
	  other than PVH ones cannot be created.

	  If unsure, say Y.

config X86_HVM_PIC
	bool "i8259 PIC emulation"
	depends on HVM
	default y
	help
	  Emulated pair of i8259 Programmable Interrupt Controllers and their
	  ELCR registers (I/O ports 0x20-0x21, 0xa0-0xa1 and 0x4d0-0x4d1).

	  PVH guests and a PVH dom0 do not use it.  Without it, HVM guests
	  other than PVH ones cannot be created.

	  If unsure, say Y.

config X86_HVM_RTC
	bool "MC146818 RTC emulation"
	depends on HVM
	default y
	help
	  Emulated real-time clock and CMOS (I/O ports 0x70-0x71).  The
	  hardware domain's mediated access to the physical RTC does not
	  depend on it.

	  PVH guests and a PVH dom0 do not use it.  Without it, HVM guests
	  other than PVH ones cannot be created.

	  If unsure, say Y.

config X86_HVM_HPET
	bool "HPET emulation"
	depends on HVM
	default y
	help
	  Emulated High Precision Event Timer.

	  PVH guests and a PVH dom0 do not use it.  Without it, HVM guests
	  other than PVH ones cannot be created.

	  If unsure, say Y.

config X86_HVM_PMTIMER
	bool "ACPI PM timer emulation"
	depends on HVM
	default y
	help
	  Emulated ACPI PM timer and PM1a event registers, which also deliver
	  the power and sleep button triggers of XEN_DOMCTL_sendtrigger.

	  PVH guests and a PVH dom0 do not use it.  Without it, HVM guests
	  other than PVH ones cannot be created.

	  If unsure, say Y.

config X86_HVM_STDVGA
	bool "Standard VGA emulation"
	depends on HVM
	default y
	help
	  Forwarding of writes to the standard VGA memory window as buffered
	  ioreqs, to speed up the device model's VGA emulation.

	  PVH guests and a PVH dom0 do not use it.  Without it, HVM guests
	  other than PVH ones cannot be created.

	  If unsure, say Y.

endmenu
```

## xen/drivers/acpi/Kconfig
```kconfig
config ACPI
	bool

config ACPI_LEGACY_TABLES_LOOKUP
	bool

config ACPI_NUMA
	bool
	select NUMA

config ACPI_APEI
	bool "ACPI Platform Error Interface (APEI)" if EXPERT
	depends on X86
	default y
	help
	  Lets Xen save the record of a fatal machine check to the firmware's
	  ERST error log, for software on the next boot to read, and read the
	  HEST table, which only the Sandy Bridge-EP PCIe AER quirk consults
	  for firmware-first handling.  Without it, fatal machine checks are
	  only printed, the hest_disable option is unknown, and that quirk
	  assumes the OS handles AER.

	  If unsure, say Y.
```

## xen/drivers/cpufreq/Kconfig
```kconfig
config HAS_CPUFREQ
	bool

config INTEL_HWP
	bool "Intel Hardware P-States driver" if EXPERT
	depends on INTEL && HAS_CPUFREQ
	default y
	help
	  The cpufreq=hwp driver, which lets Intel CPUs pick their own
	  performance state within limits Xen sets.  Without it, cpufreq=hwp
	  is an invalid option and leaves Xen without a cpufreq driver, as
	  any invalid cpufreq= value does.  The default ACPI P-state driver
	  is unaffected.

	  If unsure, say Y.

config AMD_CPPC
	bool "AMD CPPC driver" if EXPERT
	depends on AMD && HAS_CPUFREQ
	default y
	help
	  The cpufreq=amd-cppc driver, which drives AMD CPUs through ACPI
	  CPPC with the _CPC data the hardware domain uploads.  Without it,
	  cpufreq=amd-cppc is an invalid option and leaves Xen without a
	  cpufreq driver, as any invalid cpufreq= value does, and uploaded
	  CPPC data is ignored.  The default PowerNow! driver is unaffected.

	  If unsure, say Y.

config CPUFREQ_GOV_ONDEMAND
	bool "Ondemand cpufreq governor" if EXPERT
	depends on HAS_CPUFREQ
	default y
	help
	  The ondemand governor, which scales each CPU's frequency with its
	  load, and which is Xen's default governor.  Without it, the default
	  governor is performance, and asking for ondemand, with
	  cpufreq=xen:ondemand or at run time through XEN_SYSCTL_pm_op, fails.

	  If unsure, say Y.
```

## xen/drivers/passthrough/Kconfig
```kconfig
config HAS_PASSTHROUGH
	bool

config DT_PASSTHROUGH
	bool "Device tree device passthrough" if EXPERT
	depends on HAS_DEVICE_TREE_DISCOVERY && HAS_PASSTHROUGH
	default y
	help
	  Lets the toolstack assign devices described in the host device tree
	  to guests with XEN_DOMCTL_assign_device.

	  If disabled, assigning, testing or deassigning such a device fails
	  with -ENODEV, as it does on x86. Devices given to domains at boot
	  (the hardware domain, dom0less domains) and PCI devices are not
	  affected.

	  If unsure, say Y.

if ARM
config ARM_SMMU
	bool "ARM SMMUv1 and v2 driver"
	default y
	help
	  Support for implementations of the ARM System MMU architecture
	  versions 1 and 2.

	  Say Y here if your SoC includes an IOMMU device implementing the
	  ARM SMMU architecture.

config ARM_SMMU_V3
	bool "ARM Ltd. System MMU Version 3 (SMMUv3) Support" if EXPERT
	depends on ARM_64
	help
	 Support for implementations of the ARM System MMU architecture
	 version 3. Driver is in experimental stage and should not be used in
	 production.

	 Say Y here if your system includes an IOMMU device implementing
	 the ARM SMMUv3 architecture.

config IPMMU_VMSA
	bool "Renesas IPMMU-VMSA found in R-Car Gen3/Gen4 SoCs"
	depends on ARM_64
	select PCI_HOST_RCAR4 if HAS_PCI
	help
	  Support for implementations of the Renesas IPMMU-VMSA found
	  in R-Car Gen3/Gen4 SoCs.

	  Say Y here if you are using newest R-Car Gen3 SoCs revisions
	  (H3 ES3.0, M3-W+, etc) or Gen4 SoCs which IPMMU hardware supports stage 2
	  translation table format and is able to use CPU's P2M table as is.

endif

config AMD_IOMMU
	bool "AMD IOMMU" if EXPERT
	depends on X86
	default y
	help
	  Enables I/O virtualization on platforms that implement the
	  AMD I/O Virtualization Technology (IOMMU).

	  If your system includes an IOMMU implementing AMD-Vi, say Y.
	  This is required if your system has more than 254 CPUs.
	  If in doubt, say Y.

config INTEL_IOMMU
	bool "Intel VT-d" if EXPERT
	depends on X86
	default y
	help
	  Enables I/O virtualization on platforms that implement the
	  Intel Virtualization Technology for Directed I/O (Intel VT-d).

	  If your system includes an IOMMU implementing Intel VT-d, say Y.
	  This is required if your system has more than 254 CPUs.
	  If in doubt, say Y.

config IOMMU_FORCE_PT_SHARE
	bool

config PV_IOMMU
	bool "PV-IOMMU interface" if EXPERT
	depends on HAS_PASSTHROUGH
	default y
	help
	  The iommu_op hypercall, through which a domain sets up IOMMU
	  contexts besides its default one for its own devices and maps
	  memory into them, as Linux's xen-iommu driver does.  Only x86
	  guests can call it: on Arm it is not in the hypercall table, and
	  this only builds unreachable code.

	  Without it iommu_op fails with -ENOSYS, and Linux's xen-iommu
	  driver does not register.  Devices then do DMA through their
	  domain's default context, which maps all of the domain's memory,
	  so a guest kernel has no IOMMU to isolate its own devices from
	  each other or to back VFIO.

	  If unsure, say Y.

choice
	prompt "IOMMU device quarantining default behavior"
	depends on HAS_PCI
	default IOMMU_QUARANTINE_BASIC
	help
	  When a PCI device is assigned to an untrusted domain, it is possible
	  for that domain to program the device to DMA to an arbitrary address.
	  The IOMMU is used to protect the host from malicious DMA by making
	  sure that the device addresses can only target memory assigned to the
	  guest.  However, when the guest domain is torn down, assigning the
	  device back to the hardware domain would allow any in-flight DMA to
	  potentially target critical host data.  To avoid this, quarantining
	  should be enabled.  Quarantining can be done in two ways: In its basic
	  form, all in-flight DMA will simply be forced to encounter IOMMU
	  faults.  Since there are systems where doing so can cause host lockup,
	  an alternative form is available where writes to memory will be made
	  fault, but reads will be directed to a scratch page.  The implication
	  here is that such reads will go unnoticed, i.e. an admin may not
	  become aware of the underlying problem.

	config IOMMU_QUARANTINE_NONE
		bool "none"
	config IOMMU_QUARANTINE_BASIC
		bool "basic"
	config IOMMU_QUARANTINE_SCRATCH_PAGE
		bool "scratch page"
		depends on AMD_IOMMU || INTEL_IOMMU
endchoice
```
