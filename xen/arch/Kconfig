## xen/arch/Kconfig
```kconfig
config 64BIT
	bool

config PHYS_ADDR_T_32
	bool

config NR_CPUS
	int "Maximum number of CPUs"
	range 1 1 if ARM && MPU
	range 1 16383
	default "256" if X86
	default "1" if !ARM || MPU
	default "8" if RCAR3
	default "4" if QEMU
	default "4" if MPSOC
	default "256" if ARM_64
	default "128"
	help
	  Controls the build-time size of various arrays and bitmaps
	  associated with multiple-cpu management.  It is the upper bound of
	  the number of logical entities the scheduler can run code on.

	  For CPU cores which support Simultaneous Multi-Threading or similar
	  technologies, this the number of logical threads which Xen will
	  support.

	  Note that this is a build-time upper bound, not the number of CPUs
	  that will be used: the per-CPU data of CPUs which are not present is
	  never allocated.  Raising it does however grow every cpumask_t (and
	  therefore a number of structures embedding one), so platforms with a
	  known-small CPU count are better off lowering it.

config NR_NUMA_NODES
	int "Maximum number of NUMA nodes supported"
	range 2 64
	default "64"
	depends on NUMA
	help
	  Controls the build-time size of various arrays and bitmaps
	  associated with multiple-nodes management. It is the upper bound of
	  the number of NUMA nodes that the scheduler, memory allocation and
	  other NUMA-aware components can handle.
```

## xen/arch/arm/Kconfig.debug
```kconfig
choice
	bool "Early printk"
	optional
	help
	  You may want to enable early printk if you are debugging code
	  that executes before the console is initialized.

	  Note that selecting this option will limit Xen to a single UART
	  definition. Attempting to boot Xen image on a different
	  platform *will not work*, so this option should not be enable
	  for Xens that are intended to be portable.

	  Choose one of the UART drivers for early printk, then you'll
	  have to specify the parameters, like the base address.

	config EARLY_UART_CHOICE_8250
		select EARLY_UART_8250
		bool "Early printk via 8250 UART"
		help
		  Say Y here if you wish the early printk to direct their
		  output to a 8250 UART.

	config EARLY_UART_CHOICE_CADENCE
		select EARLY_UART_CADENCE
		depends on ARM_64
		bool "Early printk via Cadence UART"
		help
		  Say Y here if you wish the early printk to direct their
		  output to a Cadence UART.

	config EARLY_UART_CHOICE_EXYNOS4210
		select EARLY_UART_EXYNOS4210
		depends on ARM_32
		bool "Early printk via Exynos4210 UART"
		help
		  Say Y here if you wish the early printk to direct their
		  output to a Exynos 4210 UART.

	config EARLY_UART_CHOICE_S5L
		select EARLY_UART_S5L
		depends on ARM_64
		bool "Early printk via Apple s5l UART"
		help
		  Say Y here if you wish the early printk to direct their
		  output to an Apple "s5l" UART (compatible "apple,s5l-uart"),
		  as found on Apple Silicon (M1/M2/M3).

	config EARLY_UART_CHOICE_DOCKCHANNEL
		select EARLY_UART_DOCKCHANNEL
		depends on ARM_64
		bool "Early printk via Apple dockchannel"
		help
		  Say Y here if you wish the early printk to direct their
		  output to the Apple "dockchannel" debug FIFO, as found on
		  Apple Silicon (M1/M2/M3).

		  This is the console route used when the target's USB-C port
		  is in "debugusb" mode (macvdmtool debugusb), where the port
		  controller tunnels the dockchannel to the host as
		  /dev/cu.kis-100000-ch-0.  In "serial" mode the console
		  leaves over the s5l UART instead; pick that option there.

		  EARLY_UART_BASE_ADDRESS must be the dockchannel *data
		  window* base: reg[0] of /arm-io/dockchannel-uart in the ADT,
		  plus 0x4000.  There is no device tree node for it, so read
		  it off the machine with m1n1's shell:

		    hex(u.adt["arm-io"]["dockchannel-uart"].get_reg(0)[0] + 0x4000)

	config EARLY_UART_CHOICE_IMX_LPUART
		select EARLY_UART_IMX_LPUART
		depends on ARM_64
		bool "Early printk via i.MX LPUART"
		help
		  Say Y here if you wish the early printk to direct their
		  output to a i.MX LPUART.

	config EARLY_UART_CHOICE_LINFLEX
		select EARLY_UART_LINFLEX
		depends on ARM_64
		bool "Early printk via NXP LINFlexD UART"
		help
		  Say Y here if you wish the early printk to direct their
		  output to an NXP LINFlexD UART.

	config EARLY_UART_CHOICE_MESON
		select EARLY_UART_MESON
		depends on ARM_64
		bool "Early printk via MESON UART"
		help
		  Say Y here if you wish the early printk to direct their
		  output to a MESON UART.

	config EARLY_UART_CHOICE_MVEBU
		select EARLY_UART_MVEBU
		depends on ARM_64
		bool "Early printk via MVEBU UART"
		help
		  Say Y here if you wish the early printk to direct their
		  output to a MVEBU UART.

	config EARLY_UART_CHOICE_PL011
		select EARLY_UART_PL011
		bool "Early printk via PL011 UART"
		help
		  Say Y here if you wish the early printk to direct their
		  output to a PL011 UART.

	config EARLY_UART_CHOICE_SCIF
		select EARLY_UART_SCIF
		bool "Early printk via SCIF UART"
		help
		  Say Y here if you wish the early printk to direct their
		  output to a SCIF UART.

endchoice


config EARLY_UART_8250
	select EARLY_PRINTK
	bool
config EARLY_UART_CADENCE
	select EARLY_PRINTK
	bool
config EARLY_UART_EXYNOS4210
	select EARLY_PRINTK
	bool
config EARLY_UART_IMX_LPUART
	select EARLY_PRINTK
	bool
config EARLY_UART_LINFLEX
	select EARLY_PRINTK
	bool
config EARLY_UART_MESON
	select EARLY_PRINTK
	bool
config EARLY_UART_MVEBU
	select EARLY_PRINTK
	bool
config EARLY_UART_PL011
	select EARLY_PRINTK
	bool
config EARLY_UART_S5L
	select EARLY_PRINTK
	bool
config EARLY_UART_DOCKCHANNEL
	select EARLY_PRINTK
	bool
config EARLY_UART_SCIF
	select EARLY_PRINTK
	bool

config EARLY_PRINTK
	bool

config DEBUG_MMU_MINIMAL
	bool "Enable the MMU with the weakest possible configuration"
	depends on EARLY_PRINTK && MMU && ARM_64
	default n
	help
	  Bring the MMU up with caches and shareability taken out of the
	  picture: page table walks become Non-cacheable and Non-shareable,
	  and neither the D-cache nor the I-cache is enabled with it.

	  This is a bisection tool, not a supported configuration.  If paging
	  works like this but not with the normal Write-Back Inner-Shareable
	  setup, the problem is cache or coherency related rather than a bad
	  translation table.  Xen will be extremely slow.

	  Say N.

config EARLY_PRINTK_PAGING_DEBUG
	bool "Early printk, dump the MMU control registers before paging is on"
	depends on EARLY_PRINTK && MMU
	default n
	help
	  Print ID_AA64MMFR0_EL1, TCR_EL2, SCTLR_EL2, HCR_EL2, the page table
	  base and the root page table entry immediately before SCTLR_EL2.M is
	  set.

	  This is the only way to debug a failure to enable paging: once the
	  MMU is on, a fault has no console to report on (the vector base still
	  belongs to the bootloader, whose code is no longer mapped), so the
	  symptom of any mistake here is an indistinguishable silent hang right
	  after "- Turning on paging -".

	  Say N unless you are bringing up a new platform.

config EARLY_UART_BASE_ADDRESS
	depends on EARLY_PRINTK
	hex "Early printk, physical base address of debug UART"
	range 0x0 0xffffffff if ARM_32

config EARLY_UART_SIZE
       depends on EARLY_PRINTK
       depends on MPU
       hex "Early printk, physical size of debug UART"
       range 0x0 0xffffffff if ARM_32
       default 0x1000

config EARLY_UART_PL011_BAUD_RATE
	depends on EARLY_UART_PL011
	int "Early printk UART baud rate for pl011"
	default 0
	help
	  Optionally sets the baud rate which should be used to configure
	  the UART at start of day.

	  If EARLY_UART_PL011_BAUD_RATE is set to 0 then the code will
	  not try to initialize the UART, so that bootloader or firmware
	  settings can be used for maximum compatibility.

config EARLY_UART_PL011_MMIO32
	bool "32-bit only MMIO for PL011 early printk"
	depends on EARLY_UART_PL011
	help
	  If specified, all accesses to PL011 registers made from early printk code
	  will be done using 32-bit only accessors.

config EARLY_UART_INIT
	depends on EARLY_UART_PL011 && EARLY_UART_PL011_BAUD_RATE != 0
	def_bool y

config EARLY_UART_8250_REG_SHIFT
	depends on EARLY_UART_8250
	int "Early printk, left-shift to apply to the register offsets within the 8250 UART"
	default 0
	help
	  EARLY_UART_8250_REG_SHIFT is, optionally, the left-shift to
	  apply to the register offsets within the UART with early
	  printk.

	  Default to 0.


choice EARLY_UART_SCIF_VERSION
	prompt "Early printk UART SCIF interface version"
	depends on EARLY_UART_SCIF
	default EARLY_UART_SCIF_VERSION_NONE
	help
	  Select the interface version of the SCIF UART.

	  Select EARLY_UART_SCIF_VERSION_NONE to use the default
	  interface version (SCIF).

	config EARLY_UART_SCIF_VERSION_NONE
		bool "default SCIF UART interface"
	config EARLY_UART_SCIF_VERSION_A
		bool "SCIF UART interface version A"
endchoice

config EARLY_PRINTK_INC
	string
	default "debug-8250.inc" if EARLY_UART_8250
	default "debug-cadence.inc" if EARLY_UART_CADENCE
	default "debug-exynos4210.inc" if EARLY_UART_EXYNOS4210
	default "debug-imx-lpuart.inc" if EARLY_UART_IMX_LPUART
	default "debug-linflex.inc" if EARLY_UART_LINFLEX
	default "debug-meson.inc" if EARLY_UART_MESON
	default "debug-mvebu.inc" if EARLY_UART_MVEBU
	default "debug-pl011.inc" if EARLY_UART_PL011
	default "debug-dockchannel.inc" if EARLY_UART_DOCKCHANNEL
	default "debug-s5l.inc" if EARLY_UART_S5L
	default "debug-scif.inc" if EARLY_UART_SCIF

config PCI_DEVICE_DEBUG
	bool "PCI device debug messages"
	depends on HAS_PCI
	help
		PCI device debug
		If unsure say N
```

## xen/arch/arm/platforms/Kconfig
```kconfig
choice
	prompt "Platform Support" if MMU
	default ALL_PLAT
	help
	  Choose which hardware platform to enable in Xen.

	  If unsure, choose ALL_PLAT.

config ALL_PLAT
	bool "All Platforms"
	help
	  Enable support for all available hardware platforms. It doesn't
	  automatically select any of the related drivers.

config APPLE
	bool "Apple Silicon (M1/M2/M3) support"
	depends on ARM_64
	select GICV3
	help
	  Enable support for running Xen natively on Apple Silicon (M1/M2/M3)
	  with an Asahi Linux dom0.

	  This is work in progress: it currently provides the platform stub and
	  s5l early-console plumbing.  The Apple Interrupt Controller (AIC),
	  timer-over-FIQ, VHE (E2H=1) execution, spin-table SMP bring-up and DART
	  handling are not yet implemented.  See plans/asahi/ for the design.

	  GICV3 is selected because guests (including dom0) are presented with a
	  virtual GICv3 backed by the GICv3 CPU system-register interface that
	  Apple cores implement, even though the physical interrupt controller is
	  the AIC.

config APPLE_VZ
	bool "Apple Virtualization.framework generic platform"
	depends on ARM_64
	select GICV3
	select GICV2M
	help
	  Enable support for running Xen as a nested hypervisor inside a macOS
	  Virtualization.framework VM on Apple Silicon, with nested
	  virtualisation enabled so that the guest is entered at EL2.

	  This is a different machine from the bare-metal Apple Silicon support
	  (CONFIG_APPLE): the synthesised platform has a GICv3 rather than an
	  AIC, PSCI CPU bring-up, and no IOMMU, so Xen's generic arm64 paths
	  apply almost unchanged.  What it does not have is any UART, so Xen
	  boots with no console of its own; see
	  plans/asahi/11-virtualization-framework.md.

	  GICV2M is selected because the platform's only MSI controller is a
	  GICv2m frame, and with no usable INTx routing it is the only way the
	  hardware domain can get an interrupt out of a virtio-pci device.

config QEMU
	bool "QEMU aarch virt machine support"
	depends on ARM_64
	select GICV3
	select HAS_PL011
	help
	  Enable all the required drivers for QEMU aarch64 virt emulated
	  machine.

config RCAR3
	bool "Renesas R-Car Gen3 support"
	depends on ARM_64
	select HAS_SCIF
	select IPMMU_VMSA
	help
	  Enable support for Renesas R-Car Generation 3 SoCs (H3, M3, etc.).
	  Includes all required drivers and platform-specific features.

config RCAR4
	bool "Renesas R-Car Gen4 support"
	depends on ARM_64
	select GICV3
	select HAS_SCIF
	select HAS_ITS
	select IPMMU_VMSA
	help
	  Enable support for Renesas R-Car Generation 4 SoCs (V4H, V4M, etc.).
	  Includes all required drivers and platform-specific features.

config MPSOC
	bool "Xilinx Ultrascale+ MPSoC support"
	depends on ARM_64
	select HAS_CADENCE_UART
	select ARM_SMMU
	help
	  Enable all the required drivers for Xilinx Ultrascale+ MPSoC

config S32G3
	bool "NXP S32G3 Processors support"
	depends on ARM_64
	select HAS_LINFLEX
	select SCMI_SMC
	help
	  Enable all the required drivers for NXP S32G3 Processors Family

config NO_PLAT
	bool "No Platforms"
	help
	  Do not enable specific support for any platform.

endchoice

config ALL64_PLAT
	bool
	default (ALL_PLAT && ARM_64)

config ALL32_PLAT
	bool
	default (ALL_PLAT && ARM_32)

config APPLE_PLATFORM
	bool
	default (ALL64_PLAT || APPLE)

config APPLE_AIC
	bool "Apple Interrupt Controller (AIC) driver"
	default APPLE_PLATFORM
	depends on ARM_64
	help
	  Physical-layer driver for the Apple Interrupt Controller (AIC v1/v2/v3)
	  found on Apple Silicon.  Work in progress; see plans/asahi/.

config APPLE_VZ_PLATFORM
	bool
	default (ALL64_PLAT || APPLE_VZ)

config MPSOC_PLATFORM
	bool
	default (ALL64_PLAT || MPSOC)
```
